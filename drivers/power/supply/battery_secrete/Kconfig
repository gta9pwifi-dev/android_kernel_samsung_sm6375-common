## drivers/power/supply/battery_secrete/Kconfig
```kconfig
#
# ADI battery_secrete add
#

config ONEWIRE_GPIO
	tristate "onewire gpio driver"
	default y
	help
		It's an onewire driver.

config BATT_VERIFY
	tristate "auth battery driver"
	default y
	help
		It needs a onewire physical controller to work.

config BATT_VERIFY_BY_DS28E30
	tristate "ds28e30 driver"
	default y
	help
 		It needs a onewire physical controller to work.
```
